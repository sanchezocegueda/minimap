## esp32-prototype/components/lora/Kconfig
```kconfig
menu "LoRa Configuration"

config LORA_CS_GPIO
    int "CS GPIO"
    range 0 35
    default 13
    help
	Pin Number where the CS pin of the LoRa module is connected to.

config LORA_RST_GPIO
    int "RST GPIO"
    range 0 35
    default 35
    help
	Pin Number where the RST pin of the LoRa module is connected to.

config LORA_MISO_GPIO
    int "MISO GPIO"
    range 0 35
    default 14
    help
	Pin Number to be used as the MISO SPI signal.

config LORA_MOSI_GPIO
    int "MOSI GPIO"
    range 0 35
    default 12
    help
	Pin Number to be used as the MOSI SPI signal.

config LORA_SCK_GPIO
    int "SCK GPIO"
    range 0 35
    default 27
    help
	Pin Number to be used as the SCK SPI signal.

config LORA_DIO0_GPIO
    int "DIO0 GPIO"
    range 0 35
    default 26
    help
	Pin Number to be used as the DIO0 interrupt.

config LORA_IRQ_ENABLED
    bool "Use DIO0 as an interrupt"
    default false
    help
	Enabling this will support the functions lora_receive_packet_blocking and lora_transmit_packet_blocking.
endmenu
```

## esp32-prototype/components/lora/sdkconfig.defaults
```kconfig
# Lora
CONFIG_LORA_CS_GPIO=13
# Change RST to esp RST
CONFIG_LORA_RST_GPIO=35
CONFIG_LORA_MISO_GPIO=14
CONFIG_LORA_MOSI_GPIO=12
CONFIG_LORA_SCK_GPIO=27

# LoRa Interrupts
CONFIG_LORA_DIO0_GPIO=26
CONFIG_LORA_IRQ_ENABLED=y
```

## esp32-prototype/hardware_integration/sdkconfig.defaults
```kconfig
# Correct clock rate for serial output
CONFIG_XTAL_FREQ_26=y

# GPS Config
CONFIG_NMEA_PARSER_UART_RXD=33
CONFIG_NMEA_STATEMENT_GGA=y
CONFIG_NMEA_STATEMENT_GSA=y
CONFIG_NMEA_STATEMENT_GSV=y
CONFIG_NMEA_STATEMENT_RMC=y
CONFIG_NMEA_STATEMENT_GLL=n
CONFIG_NMEA_STATEMENT_VTG=n

# Screen Config
CONFIG_LV_CONF_SKIP=y
CONFIG_LV_USE_OBSERVER=y
CONFIG_LV_USE_SYSMON=y
CONFIG_EXAMPLE_LCD_CONTROLLER_GC9A01=y

# Lora
CONFIG_LORA_CS_GPIO=13
CONFIG_LORA_MISO_GPIO=14
CONFIG_LORA_MOSI_GPIO=12
CONFIG_LORA_SCK_GPIO=27
# LoRa Interrupts
CONFIG_LORA_DIO0_GPIO=26
CONFIG_LORA_IRQ_ENABLED=y
```

## esp32-prototype/lora-library/sdkconfig.defaults
```kconfig
# Correct clock rate for serial output
CONFIG_XTAL_FREQ_26=y

# GPS Config
CONFIG_NMEA_PARSER_UART_RXD=33
CONFIG_NMEA_STATEMENT_GGA=y
CONFIG_NMEA_STATEMENT_GSA=y
CONFIG_NMEA_STATEMENT_GSV=y
CONFIG_NMEA_STATEMENT_RMC=y
CONFIG_NMEA_STATEMENT_GLL=n
CONFIG_NMEA_STATEMENT_VTG=n

# Lora
CONFIG_LORA_CS_GPIO=13
# Change RST to esp RST
CONFIG_LORA_RST_GPIO=35
CONFIG_LORA_MISO_GPIO=14
CONFIG_LORA_MOSI_GPIO=12
CONFIG_LORA_SCK_GPIO=27
# LoRa Interrupts
CONFIG_LORA_DIO0_GPIO=26
CONFIG_LORA_IRQ_ENABLED=y
```

## esp32-prototype/screen_imu_gps/sdkconfig.defaults
```kconfig
# Correct clock rate for serial output
CONFIG_XTAL_FREQ_26=y

# GPS Config
CONFIG_NMEA_PARSER_UART_RXD=18
CONFIG_NMEA_STATEMENT_GGA=y
CONFIG_NMEA_STATEMENT_GSA=y
CONFIG_NMEA_STATEMENT_GSV=y
CONFIG_NMEA_STATEMENT_RMC=y
CONFIG_NMEA_STATEMENT_GLL=n
CONFIG_NMEA_STATEMENT_VTG=n

# Screen Config
CONFIG_LV_CONF_SKIP=y
CONFIG_LV_USE_OBSERVER=y
CONFIG_LV_USE_SYSMON=y
CONFIG_EXAMPLE_LCD_CONTROLLER_GC9A01=y
```

## esp32-prototype/spi_lcd_touch/sdkconfig.defaults
```kconfig
CONFIG_LV_CONF_SKIP=y
CONFIG_LV_USE_OBSERVER=y
CONFIG_LV_USE_SYSMON=y
CONFIG_EXAMPLE_LCD_CONTROLLER_GC9A01=y
```
